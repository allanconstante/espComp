## components/ac_driver_controller/Kconfig.projbuild
```kconfig
menu "Driver configurations"

    menu "DHT sensor configuration"

        config DHT_DRIVER_ENABLE
            bool "Enable driver"
            default "n"
            help
                xxxx.
        
        config GPIO_NUMBER
            int "GPIO number"
            range 0 48
            default 18
            depends on DHT_DRIVER_ENABLE
            help
                GPIO number (IOxx) for communication with the sensor.
                Some GPIOs are used for other purposes (flash connections, etc.) and cannot be used.
        
        choice MODEL
            prompt "Sensor model"
            default DHT11
            depends on DHT_DRIVER_ENABLE
            help
                Defines the default model for the sensor

            config DHT11
                bool "DHT11"
            config DHT22
                bool "DHT22"
        endchoice

        choice TIMER
            prompt "Timer"
            default TIMER_0_GROUP_0
            depends on DHT_DRIVER_ENABLE
            help
                Defines default timer to use with sensor.
            
            config GROUP_0_TIMER_0
                bool "Group:0 Timer:0"
            config GROUP_0_TIMER_1
                bool "Group:0 Timer:1"
            config GROUP_1_TIMER_0
                bool "Group:1 Timer:0"
            config GROUP_1_TIMER_1
                bool "Group:1 Timer:1"
        endchoice

    endmenu

    menu "Wifi configuration"

        config WIFI_DRIVER_ENABLE
            bool "Enable driver"
            default "n"
            help
                xxxx.
        
        config WIFI_SSID
            string "Wifi SSID"
            default "SSID"
            depends on WIFI_DRIVER_ENABLE
            help
                xxxx.

        config WIFI_PASSWORD
            string "Password"
            default "Password"
            depends on WIFI_DRIVER_ENABLE
            help
                xxxx.
        
        config MAXIMUM_RETRY
            int "Maximum retry"
            range 0 50
            default 10
            depends on WIFI_DRIVER_ENABLE
            help
                Maximum number of attempts to reconnect to wifi.

    endmenu

endmenu
```

## components/ac_esp_driver_wifi/Kconfig.projbuild
```kconfig
menu "Wifi configuration"
        
    config WIFI_SSID
        string "Wifi SSID"
        default "SSID"
        help
            xxxx.

    config WIFI_PASSWORD
        string "Password"
        default "Password"
        help
            xxxx.
        
    config MAXIMUM_RETRY
        int "Maximum retry"
        range 0 50
        default 10
        help
            Maximum number of attempts to reconnect to wifi.
            
endmenu
```
